## meta-balena-common/conf/distro/uinta-systemd.conf
```bitbake
# Add OS flavor
require conf/distro/include/uinta-os.inc

# Systemd please
DISTRO_FEATURES:append = " systemd"
VIRTUAL-RUNTIME_init_manager = "systemd"
DISTRO_FEATURES_BACKFILL_CONSIDERED = "sysvinit"
VIRTUAL-RUNTIME_base-utils-syslog = ""
```
